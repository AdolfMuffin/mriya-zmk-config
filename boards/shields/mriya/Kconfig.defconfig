## boards/shields/mriya/Kconfig.defconfig
```kconfig
if SHIELD_MRIYA_CENTRAL_DONGLE

config ZMK_KEYBOARD_NAME
    default "MRIYA"

config ZMK_SPLIT_ROLE_CENTRAL
    default y

config ZMK_USB
	default y

config ZMK_SPLIT_BLE
    default y

config ZMK_SLEEP
    default n

config ZMK_KSCAN_GPIO_DRIVER
    default n

endif

if SHIELD_MRIYA_PERIPHERAL_LEFT || SHIELD_MRIYA_PERIPHERAL_RIGHT

config ZMK_SPLIT
    default y

if ZMK_DISPLAY

config I2C
    default y

config SSD1306
    default y

endif # ZMK_DISPLAY

if LVGL

config LV_Z_VDB_SIZE
    default 64

config LV_DPI_DEF
    default 148

config LV_Z_BITS_PER_PIXEL
    default 1

choice LV_COLOR_DEPTH
    default LV_COLOR_DEPTH_1
endchoice

endif # LVGL

endif
```
